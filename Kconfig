## Kconfig
```kconfig
config ZMK_BEHAVIOR_PORTABLE_ACCENT
    bool "Portable Portuguese accents behavior"
    default y
    depends on ZMK_BLE
    help
      Generates Linux Unicode or Windows Alt+numpad input according to the
      active Bluetooth profile. Android uses the Linux sequence best-effort.
```

## dts/bindings/behaviors/zmk,behavior-portable-accent.yaml
```yaml
description: Profile-selected portable Portuguese accent behavior
compatible: "zmk,behavior-portable-accent"
include: one_param.yaml
```
